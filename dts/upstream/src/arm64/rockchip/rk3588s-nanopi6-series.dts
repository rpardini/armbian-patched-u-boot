// SPDX-License-Identifier: (GPL-2.0+ OR MIT)

/dts-v1/;

#include "rk3588s-nanopi-r6s.dts"

/ {
	model = "FriendlyElec NanoPi 6 series (U-Boot)";
	compatible = "friendlyelec,nanopi6-series", "rockchip,rk3588s";

};

/*
 * M6 eMMC and FSPI-M0 share pins.  The pre-DM SPL hook selects exactly one
 * controller after reading the BootROM source.
 */
&sdhci {
	status = "disabled";
};

&sfc {
	pinctrl-names = "default";
	pinctrl-0 = <&fspim0_pins>;
	status = "disabled";

	flash@0 {
		compatible = "jedec,spi-nor";
		reg = <0>;
		spi-max-frequency = <50000000>;
		spi-rx-bus-width = <4>;
		spi-tx-bus-width = <1>;
	};
};
