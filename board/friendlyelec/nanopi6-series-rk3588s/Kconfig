## board/friendlyelec/nanopi6-series-rk3588s/Kconfig
```kconfig
if TARGET_NANOPI6_SERIES_RK3588S

config SYS_BOARD
	default "nanopi6-series-rk3588s"

config SYS_VENDOR
	default "friendlyelec"

config SYS_CONFIG_NAME
	default "nanopi6-series-rk3588s"

endif
```

## board/mediatek/genio-1200-evk/Kconfig
```kconfig
if TARGET_MT8195

config SYS_BOARD
	default "genio-1200-evk"

config SYS_CONFIG_NAME
	default "mt8195"

endif
```

## board/mediatek/genio-350-evk/Kconfig
```kconfig
if TARGET_MT8365

config SYS_BOARD
	default "genio-350-evk"

config SYS_CONFIG_NAME
	default "mt8365"

config MTK_BROM_HEADER_INFO
	string
	default "media=emmc"

endif
```

## board/mediatek/genio-510-evk/Kconfig
```kconfig
if TARGET_MT8370

config SYS_BOARD
	default "genio-510-evk"

config SYS_CONFIG_NAME
	default "mt8370"

endif
```

## board/mediatek/genio-700-evk/Kconfig
```kconfig
if TARGET_MT8188

config SYS_BOARD
	default "genio-700-evk"

config SYS_CONFIG_NAME
	default "mt8188"

endif
```

## board/mediatek/genio-720-evk/Kconfig
```kconfig
if TARGET_MT8391

config SYS_BOARD
	default "genio-720-evk"

config SYS_CONFIG_NAME
	default "mt8391"

endif
```

## drivers/usb/tcpm/Kconfig
```kconfig
# SPDX-License-Identifier: GPL-2.0

config TYPEC_TCPM
	bool "USB Type-C Port Controller Manager"
	depends on DM
	help
	  The Type-C Port Controller Manager provides a USB PD and USB Type-C
	  state machine for use with Type-C Port Controllers.

config TYPEC_FUSB302
	bool "Fairchild FUSB302 Type-C chip driver"
	depends on DM && DM_I2C && TYPEC_TCPM
	help
	  The Fairchild FUSB302 Type-C chip driver that works with
	  Type-C Port Controller Manager to provide USB PD and USB
	  Type-C functionalities.

config TYPEC_TCPM_DEBUG_VERBOSE
	bool "Verbose TCPM/FUSB302 tracing (DEBUG, breaks PD timing)"
	depends on TYPEC_TCPM
	help
	  Trace every FUSB302 register write and dump all PD messages and
	  PDOs on the console. Printing at 1.5 Mbaud makes the sink miss
	  the ~25 ms tSenderResponse window for its Request, causing the
	  source to issue a Hard Reset. Only enable for offline analysis.
```
