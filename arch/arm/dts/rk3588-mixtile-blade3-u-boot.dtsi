#include "rk3588-u-boot.dtsi"

/* Make the non-power USB port work with gadget/UMS */
&u2phy0 {
	status = "okay";
};

&u2phy0_otg {
	status = "okay";
};

&usb_host0_xhci {
	dr_mode = "peripheral";
	maximum-speed = "high-speed";
	phys = <&u2phy0_otg>;
	phy-names = "usb2-phy";
	status = "okay";
};
