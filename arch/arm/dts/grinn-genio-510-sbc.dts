// SPDX-License-Identifier: GPL-2.0 OR MIT
/*
 * Copyright (C) 2025 Grinn sp. z o.o.
 * Author: Bartosz Bilas <bartosz.bilas@grinn-global.com>
 */

/dts-v1/;

#include <config.h>

#include "mt8370.dtsi"
#include "mt6359.dtsi"
#include "grinn-genio-som.dtsi"
#include "grinn-genio-sbc.dtsi"

/ {
	model = "Grinn GenioSBC-510";
	compatible = "grinn,genio-510-sbc", "mediatek,mt8370";
	memory@40000000 {
		/* 4GB */
		device_type = "memory";
		reg = <0 0x40000000 1 0x00000000>;
	};
};
