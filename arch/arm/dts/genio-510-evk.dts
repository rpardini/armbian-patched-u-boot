// SPDX-License-Identifier: GPL-2.0 OR MIT
/*
 * Copyright (C) 2023 MediaTek Inc.
 * Author: Macpaul Lin <macpaul.lin@mediatek.com>
 */

/dts-v1/;

#include <genio-510-evk-common.dtsi>

/ {
	model = "MediaTek Genio-510 EVK";
	compatible = "mediatek,genio-510-evk", "mediatek,mt8370";
};
