// SPDX-License-Identifier: GPL-2.0 OR MIT
/*
 * Copyright (C) 2022 MediaTek Inc.
 * Author: Chris-QJ Chen <chris-qj.chen@mediatek.com>
 */

/dts-v1/;

#include "genio-700-evk-common.dtsi"

/ {
	model = "MediaTek Genio-700 EVK";
	compatible = "mediatek,genio-700-evk", "mediatek,mt8188";
};
