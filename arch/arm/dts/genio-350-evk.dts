// SPDX-License-Identifier: GPL-2.0 OR MIT
/*
 * Copyright (C) 2022 BayLibre SAS.
 * Author: Julien Masson <jmasson@baylibre.com>
 */

/dts-v1/;

#include "genio-350-evk-common.dtsi"

/ {
	model = "MediaTek Genio-350 EVK";
	compatible = "mediatek,genio-350-evk", "mediatek,mt8365";

	memory@40000000 {
		device_type = "memory";
		reg = <0 0x40000000 0 0xC0000000>;
	};
};
