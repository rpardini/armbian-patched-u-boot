// SPDX-License-Identifier: GPL-2.0 OR MIT
/*
 * Copyright (C) 2023 MediaTek Inc.
 * Author: Macpaul Lin <macpaul.lin@mediatek.com>
 */

/dts-v1/;

#include "genio-1200-evk-common.dtsi"

/ {
	model = "MediaTek Genio-1200 EVK";
	compatible = "mediatek,genio-1200-evk", "mediatek,mt8195";
};
