// SPDX-License-Identifier: GPL-2.0 OR MIT
/*
 * Copyright (C) 2021 BayLibre SAS.
 * Author: Fabien Parent <fparent@baylibre.com>
 */

/dts-v1/;

#include "genio-350-evk-common.dtsi"

/ {
	model = "MT8365 pumpkin board";
	compatible = "mediatek,mt8365-pumpkin", "mediatek,mt8365";

	memory@40000000 {
		device_type = "memory";
		reg = <0 0x40000000 0 0x80000000>;
	};
};
