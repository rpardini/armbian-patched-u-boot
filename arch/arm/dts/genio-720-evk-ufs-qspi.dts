// SPDX-License-Identifier: GPL-2.0 OR MIT
/*
 * Copyright (C) 2025 MediaTek Inc.
 * Author: Macpaul Lin <macpaul.lin@mediatek.com>
 */

/dts-v1/;

#include "genio-720-evk-common.dtsi"

/ {
	model = "MediaTek Genio-720 EVK with UFS and QSPI NOR Flash storage";
	compatible = "mediatek,genio-720-evk-ufs-qspi", "mediatek,mt8391";
};

&ufshci {
	status = "okay";
};
